# file: Practica2.ioc
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Mcu.Family=STM32F4
Mcu.Name=STM32F401R(B-C)Tx
Mcu.Package=LQFP64
NVIC.PriorityGroup=NVIC_PRIORITYGROUP_4
PC13-ANTI_TAMP.GPIO_PuPd=GPIO_PULLDOWN
PC13-ANTI_TAMP.Signal=GPIO_Output
ProjectManager.HeapSize=0x200
ProjectManager.StackSize=0x400
ProjectManager.TargetToolchain=STM32CubeIDE
RCC.AHBFreq_Value=16000000
RCC.APB1Freq_Value=16000000
RCC.APB2Freq_Value=16000000
RCC.CortexFreq_Value=16000000
RCC.HSE_VALUE=25000000
RCC.HSI_VALUE=16000000
RCC.LSE_VALUE=32768
RCC.SYSCLKFreq_VALUE=16000000
RCC.VCOOutputFreq_Value=192000000
board=custom

// file: Core/Src/main.c
/* USER CODE BEGIN Header */
/**
  ******************************************************************************
  * @file           : main.c
  * @brief          : Main program body
  ******************************************************************************
  * @attention
  *
  * Copyright (c) 2023 STMicroelectronics.
  * All rights reserved.
  *
  * This software is licensed under terms that can be found in the LICENSE file
  * in the root directory of this software component.
  * If no LICENSE file comes with this software, it is provided AS-IS.
  *
  ******************************************************************************
  */
/* USER CODE END Header */
#include "main.h"

void SystemClock_Config(void);
static void MX_GPIO_Init(void);

void delayInit( delay_t * delay, tick_t duration )
{
	delay->duration=duration;
	delay->running=false;

}

bool_t delayRead(delay_t * delay)
{
	if(delay->running==false)//si no esta en delay, entra
	{
		delay->running=true;
		delay->startTime=HAL_GetTick();//obtiene el tiempo actual
	}
	else
	{
		if(HAL_GetTick()-delay->startTime>=delay->duration)//compara la delta del tiempo actual contra la duracion en ms
			{
			delay->running=false;//si se ha cumplido la condicion el retardo cambia false
			return true;//retorna un valor verdadero y regresa

			}
	}
	return false;//si no se ha cumplido la condicion de tiempo, retorna falso
}

void delayWrite(delay_t*delay, tick_t duration)
{
	delay->duration=duration;//permite cambiar el valor de duracion
}

int main(void)
{

  /* MCU Configuration--------------------------------------------------------*/

  /* Reset of all peripherals, Initializes the Flash interface and the Systick. */
  HAL_Init();

  /* Configure the system clock */
  SystemClock_Config();

  /* Initialize all configured peripherals */
  MX_GPIO_Init();
  /* USER CODE BEGIN 2 */

  tick_t const cicloDeTrabajo =2; //ciclo de trabajo =1/ct
  tick_t const duration[3]={1000/cicloDeTrabajo,200/cicloDeTrabajo,100/cicloDeTrabajo};//arreglo con los tiempos
  delay_t delay;						// estructura de el retardo
  delay_t* p_delay=&delay;				//puntoro a la estructura
  delayInit(p_delay, duration[0]);		//inicializacion de la estructura del retardo
  bool_t state;							//estado del retardo, permite conocer si ha alcanzado el tiempo
  uint8_t i=0,j=0;
  uint8_t const parpadeo=10;// 10 para 5 parpadeos, se debe colocar el doble

  /* USER CODE END 2 */
  //delayWrite(delay,duration);
  /* Infinite loop */
  while (1)
  {
	  	  state=delayRead(p_delay);//se obtiene el estado el retardo, es verdadera si se ha alcanzo el tiempo solicitado
	  	  delayWrite(p_delay,duration[j]);//modifica el valor de la duracion de delay a traves de un arreglo,
		  if(state)//entra a la condicion cada vez que la funcion delayRead es verdadera
		  {
			  HAL_GPIO_TogglePin(GPIOC, GPIO_PIN_13);//pin13 del puerto C, prende y apaga
			  i++;										//veces que ha entrado en el ciclo
		  }
		  if(i>parpadeo)
		  {
			  i=0;//si se ha cumplido la condicion de parpadeos reinicia el contador i a cero
			  j++;//contador para llevar control de las veces que ha parpadeado
			  if(j>(sizeof (duration)/sizeof (duration[0]) -1))// limita al numero maximo de rutinas
				  j=0;//si se ha alcanzado la maxima cantidad de rutinas reinicia a la primera
		  }

  }

}

void SystemClock_Config(void)
{
  RCC_OscInitTypeDef RCC_OscInitStruct = {0};
  RCC_ClkInitTypeDef RCC_ClkInitStruct = {0};

  /** Configure the main internal regulator output voltage
  */
  __HAL_RCC_PWR_CLK_ENABLE();
  __HAL_PWR_VOLTAGESCALING_CONFIG(PWR_REGULATOR_VOLTAGE_SCALE2);

  /** Initializes the RCC Oscillators according to the specified parameters
  * in the RCC_OscInitTypeDef structure.
  */
  RCC_OscInitStruct.OscillatorType = RCC_OSCILLATORTYPE_HSI;
  RCC_OscInitStruct.HSIState = RCC_HSI_ON;
  RCC_OscInitStruct.HSICalibrationValue = RCC_HSICALIBRATION_DEFAULT;
  RCC_OscInitStruct.PLL.PLLState = RCC_PLL_NONE;
  if (HAL_RCC_OscConfig(&RCC_OscInitStruct) != HAL_OK)
  {
    Error_Handler();
  }

  /** Initializes the CPU, AHB and APB buses clocks
  */
  RCC_ClkInitStruct.ClockType = RCC_CLOCKTYPE_HCLK|RCC_CLOCKTYPE_SYSCLK
                              |RCC_CLOCKTYPE_PCLK1|RCC_CLOCKTYPE_PCLK2;
  RCC_ClkInitStruct.SYSCLKSource = RCC_SYSCLKSOURCE_HSI;
  RCC_ClkInitStruct.AHBCLKDivider = RCC_SYSCLK_DIV1;
  RCC_ClkInitStruct.APB1CLKDivider = RCC_HCLK_DIV1;
  RCC_ClkInitStruct.APB2CLKDivider = RCC_HCLK_DIV1;

  if (HAL_RCC_ClockConfig(&RCC_ClkInitStruct, FLASH_LATENCY_0) != HAL_OK)
  {
    Error_Handler();
  }
}

static void MX_GPIO_Init(void)
{
  GPIO_InitTypeDef GPIO_InitStruct = {0};

  /* GPIO Ports Clock Enable */
  __HAL_RCC_GPIOC_CLK_ENABLE();

  /*Configure GPIO pin Output Level */
  HAL_GPIO_WritePin(GPIOC, GPIO_PIN_13, GPIO_PIN_RESET);

  /*Configure GPIO pin : PC13 */
  GPIO_InitStruct.Pin = GPIO_PIN_13;
  GPIO_InitStruct.Mode = GPIO_MODE_OUTPUT_PP;
  GPIO_InitStruct.Pull = GPIO_PULLDOWN;
  GPIO_InitStruct.Speed = GPIO_SPEED_FREQ_LOW;
  HAL_GPIO_Init(GPIOC, &GPIO_InitStruct);

}

void Error_Handler(void)
{
  __disable_irq();
  while (1)
  {
  }
}
